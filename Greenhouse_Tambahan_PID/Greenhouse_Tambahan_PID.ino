#include <Wire.h>
#include <LiquidCrystal_I2C.h>
#include <ESP8266WiFi.h>
#include <PubSubClient.h>
#include <Arduino.h>
#include <IRremoteESP8266.h>
#include <IRsend.h>
#include "DHT.h"
#define DHTTYPE DHT21 
#define relay1 D7
#define in1 D4
#define in2 D5
#define enA D6
#define pot A0

const uint16_t IR_LED = 12;
IRsend irsend(IR_LED);
const int dht_dpin = 0;
LiquidCrystal_I2C lcd(0x27, 20, 4);

DHT dht(dht_dpin, DHTTYPE); 

//=================RTC=======================

#include "RTClib.h"
RTC_DS3231 rtc;
char daysOfTheWeek[7][12] = {"Minggu", "Senin", "Selasa", "Rabu", "Kamis", "Jumat", "Sabtu"};

//=================SENSOR DHT21===============

int suhu, kelembaban;
float t; 
float h;
//=================PID Suhu===============
int ac_out = 0;
int last_ac = 0;
int last_kipas = 0;
unsigned long wkt;
float err,errp=0,set=26;
float iState=0; // Integrator state is the sum of all the preceding inputs
float Ki=0.22, Kp=4.32, Kd=21.6; // PID gain
float pTerm, dTerm, iTerm, uTerm;
float dt=1;
//=================PID Kelembaban===============
int kipas_out = 0;
int kipas_ac = 0;
unsigned long wktk;
float errk,errpk=0,setk=80;
float iStatek=0; // Integrator state is the sum of all the preceding inputs
float Kik=0.25, Kpk=9.5, Kdk=4.75; // PID gain
float pTermk, dTermk, iTermk, uTermk;
float dtk=1;
//================= MQTT =====================

const char* ssid = "UNDIKANet";
const char* password = "SemangatPagi:)";

#define mqttserver "broker.hivemq.com"
#define mqttport 1883

WiFiClient espClient;
PubSubClient client (espClient);

void setup() {
  // put your setup code here, to run once:
  
  Serial.begin(115200);
  pinMode(in1, OUTPUT);
  pinMode(in2, OUTPUT);
  pinMode(enA, OUTPUT);
  
  //**RTC
  if (! rtc.begin()) 
  {
    Serial.println("Couldn't find RTC");
    while (1);
  }
  if (rtc.lostPower()) 
  {
    Serial.println("RTC lost power, lets set the time!");
    rtc.adjust(DateTime(F(__DATE__), F(__TIME__)));     // following line sets the RTC to the date & time this sketch was compiled
    
    // Set the current date, and time in the following format:
    // rtc.adjust(DateTime(2014, 1, 21, 3, 0, 0));     // This line sets the RTC with an explicit date & time, for example to set
  }
  
  dht.begin();
  delay(3000); 
  lcd.begin();
  lcd.backlight();
  pinMode(relay1, OUTPUT);

  irsend.begin();
#if ESP8266
  Serial.begin(115200, SERIAL_8N1, SERIAL_TX_ONLY);
#else  // ESP8266
  Serial.begin(115200, SERIAL_8N1);
#endif  // ESP8266

  //==============MQTT=====================
  WiFi.begin (ssid, password);
  while (WiFi.status() != WL_CONNECTED)
  {
    delay (500);
    Serial.println ("Connecting to WiFi..");
  }
  
  Serial.println ("Connected to the WiFi network");
  client.setServer (mqttserver, mqttport);

  while ( !client.connected()) 
  {
    client.connect("skuybos");
    Serial.print(".");
    delay(500);
  }  
}

void loop() 
{
  // put your main code here, to run repeatedly:
  ambilrtc();
  sensor();
  ambilLCD();
  ambilpid_suhu();
  ambilac();
  ambilpid_kelembaban ();
  ambilkelembaban();
  
  if (!client.connected()){
  Reconnect();
  }
  Serial.println("____________________Update________________________");
  delay(3000); 

}

void Reconnect() 
{
  while (!client.connected()) {
    Serial.print("Coba connect ke MQTT...");
    if (client.connect("client_sister")) {
      Serial.println("Connected");
    }
    else {
      Serial.print("Filed,...");
      Serial.println("Tunggu 5 detik");
      delay(5000);
    }
  }
}

void sensor()
{
  t = dht.readTemperature();  
  h = dht.readHumidity();  
  Serial.print("Suhu = ");
  Serial.print(t); 
  Serial.print("°C  ");
  Serial.print("Kelembaban Udara = ");
  Serial.print(h);
  Serial.println("%  ");
  char hasil[5];
  char bacot[4];
  dtostrf(t, 1, 2, hasil);
  dtostrf(h, 1, 2, bacot);
  client.publish("SuhuMaya", hasil);
  client.publish("gantibos", bacot);
}

void ambilLCD()
{
  suhu = t;
  kelembaban = h; 
  lcd.clear();
  lcd.setCursor(0,0); lcd.print("Suhu      : "); lcd.print(suhu);lcd.print("C");
  lcd.setCursor(0,1); lcd.print("Kel Udara : "); lcd.print(kelembaban); lcd.print("%");
}

void ambilrtc()
{
  DateTime now = rtc.now();
  Serial.println("Tanggal : ");
  Serial.print(daysOfTheWeek[now.dayOfTheWeek()]);

  Serial.print(now.day(), DEC);
  Serial.print('/');
  Serial.print(now.month(), DEC);
  Serial.print('/');
  Serial.println(now.year(), DEC);
  Serial.print("Jam : ");

  Serial.print(now.hour(), DEC);
  Serial.print(':');
  Serial.print(now.minute(), DEC);
  Serial.print(':');
  Serial.print(now.second(), DEC);
  Serial.println();
  
  if(now.hour() >= 6&& now.hour() < 15)
  {
    digitalWrite(relay1, HIGH);
    Serial.println("Lampu UV ON");
  }
  else
  {
   digitalWrite(relay1, LOW);
   Serial.println("Lampu UV OFF");
  }
}

void ambilpid_suhu()
{
  err = set - t;
  pTerm = Kp * err;
  iState = iState + (err*dt);
  if(iState <= -4) iState=-4;
  if(iState >= 1)iState=1;
  iTerm = Ki * iState;
  dTerm = Kd * (err-errp)/dt;
  errp = err;
  uTerm = pTerm + iTerm + dTerm;
  ac_out = (int)(t + uTerm);
  if(ac_out<=16) ac_out = 16;
  if(ac_out>=30) ac_out = 30;
  Serial.print("Nilai AC Out = ");
  Serial.println  (ac_out);
}

void ambilac()
{
  if(ac_out != last_ac)
  {
    int khz = 38;
    if(ac_out == 16)
    {
    uint16_t rawData[273] = {3492, 3520,  894, 2572,  894, 892,  890, 896,  892, 894,894, 2574,  866,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 3530,  918};  // UNKNOWN C31EC8C8
    irsend.sendRaw(rawData, sizeof(rawData) / sizeof(rawData[0]), khz); //Note the approach used to automatically calculate the size of the array.
    }
    else if(ac_out == 17)
    {
    uint16_t rawData[271] = {3494, 3520,  920, 866,  894, 2574,  894, 892,  894, 892,  896, 2572,  892,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 3556,  918};  // PANASONIC_AC32 AF23604
    irsend.sendRaw(rawData, sizeof(rawData) / sizeof(rawData[0]), khz);
    }
    else if(ac_out == 18)
    {
    uint16_t rawData[271] = {3464, 3548,  924, 2542,  894, 2574,  896, 890,  922, 866,  894, 2572,  894,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 3560,  892};  // PANASONIC_AC32 AF33604
    irsend.sendRaw(rawData, sizeof(rawData) / sizeof(rawData[0]), khz);
    }
    else if(ac_out == 19)
    {
    uint16_t rawData[271] = {3468, 3546,  924, 862,  896, 890,  894, 2572,  894, 892,  894, 2572,  866,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 3556,  922};  // PANASONIC_AC32 AF43604
    irsend.sendRaw(rawData, sizeof(rawData) / sizeof(rawData[0]), khz);
    }
    else if(ac_out == 20)
    {
    uint16_t rawData[271] = {3442, 3546,  896, 2570,  894, 892,  894, 2572,  920, 864,  896, 2570,  922,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 3558,  894};  // PANASONIC_AC32 AF53604
    irsend.sendRaw(rawData, sizeof(rawData) / sizeof(rawData[0]), khz);
    }
    else if(ac_out == 21)
    {
    uint16_t rawData[271] = {3468, 3520,  894, 892,  894, 2548,  916, 2570,  896, 888,  896, 2570,  950,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 3558,  892};  // PANASONIC_AC32 AF63604
    irsend.sendRaw(rawData, sizeof(rawData) / sizeof(rawData[0]), khz);
    }
    else if(ac_out == 22)
    {
    uint16_t rawData[273] = {3460, 3548,  898, 2568,  868, 2596,  868, 2598,  894, 890,  896, 2570,  896,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 3556,  894};  // UNKNOWN FDD60DF1
    irsend.sendRaw(rawData, sizeof(rawData) / sizeof(rawData[0]), khz);
    }
    else if(ac_out == 23)
    {
    uint16_t rawData[271] = {3460, 3548,  894, 892,  894, 890,  922, 864,  894, 2570,  866, 2598,  896,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 3556,  892};  // PANASONIC_AC32 AF83604
    irsend.sendRaw(rawData, sizeof(rawData) / sizeof(rawData[0]), khz);
    }
    else if(ac_out == 24)
    {
    uint16_t rawData[273] = {3436, 3572,  894, 2570,  896, 888,  894, 892,  896, 2568,  896, 2570,  868,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 3558,  892};  // UNKNOWN AB4923F5
    irsend.sendRaw(rawData, sizeof(rawData) / sizeof(rawData[0]), khz);
    }
    else if(ac_out == 25)
    {
    uint16_t rawData[271] = {3436, 3572,  896, 890,  894, 2546,  918, 890,  922, 2542,  896, 2570,  896,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 3556,  892};  // PANASONIC_AC32 AFA3604
    irsend.sendRaw(rawData, sizeof(rawData) / sizeof(rawData[0]), khz);
    }
    else if(ac_out == 26)
    {
    uint16_t rawData[271] = {3490, 3518,  890, 2574,  864, 2600,  892, 892,  892, 2574,  890, 2574,  892,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 3554,  892};  // PANASONIC_AC32 AFB3604
    irsend.sendRaw(rawData, sizeof(rawData) / sizeof(rawData[0]), khz);
    }
    else if(ac_out == 27)
    {
    uint16_t rawData[271] = {3490, 3518,  922, 862,  894, 890,  896, 2570,  894, 2570,  896, 2570,  894,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 3558,  918};  // PANASONIC_AC32 AFC3604
    irsend.sendRaw(rawData, sizeof(rawData) / sizeof(rawData[0]), khz);
    }
    else if(ac_out == 28)
    {
    uint16_t rawData[271] = {3462, 3524,  916, 2570,  894, 890,  896, 2570,  896, 2568,  896, 2570,  894,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 3554,  892};  // PANASONIC_AC32 AFD3604
    irsend.sendRaw(rawData, sizeof(rawData) / sizeof(rawData[0]), khz);
    }
    else if(ac_out == 29)
    {
    uint16_t rawData[271] = {3462, 3544,  924, 862,  894, 2570,  892, 2572,  892, 2572,  894, 2572,  892,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 3554,  920};  // PANASONIC_AC32 AFE3604
    irsend.sendRaw(rawData, sizeof(rawData) / sizeof(rawData[0]), khz);
    }
    else if(ac_out == 30)
    {
    uint16_t rawData[293] = {3462, 3546,  896, 2570,  894, 2570,  896, 2570,  892, 2572,  894, 2570,  920,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 4164,  174};  // UNKNOWN 9025144F
    irsend.sendRaw(rawData, sizeof(rawData) / sizeof(rawData[0]), khz);
    }
  last_ac = ac_out;
}
}
void ambilpid_kelembaban()
{
  errk = setk - h;
  pTermk = Kpk * errk;
  iStatek = iStatek + (errk*dtk);
  if(iStatek <= -4) iStatek=-4;
  if(iStatek >= 1)iStatek=1;
  iTermk = Kik * iStatek;
  dTermk = Kdk * (errk-errpk)/dtk;
  errpk = errk;
  uTermk = pTermk + iTermk + dTermk;
  kipas_out = (int)(h + uTermk);
  if(kipas_out<=0) kipas_out = 0;
  if(kipas_out>=1024) kipas_out = 1024;
  Serial.println("Nilai kipas out = ");
  Serial.print(kipas_out);
}
void ambilkelembaban()
{
  if(kipas_out != last_kipas)
  {
    if(kipas_out == 400)
    {
    analogWrite(enA, 400);
    digitalWrite(in1, HIGH);
    digitalWrite(in2, LOW);
    }
    else if(kipas_out == 600)
    {
    analogWrite(enA, 600);
    digitalWrite(in1, HIGH);
    digitalWrite(in2, LOW);
    }
    else if(kipas_out  == 800)
    {
    analogWrite(enA, 800);
    digitalWrite(in1, HIGH);
    digitalWrite(in2, LOW);
    }
    else if(kipas_out  == 900)
    {
    analogWrite(enA, 900);
    digitalWrite(in1, HIGH);
    digitalWrite(in2, LOW);
    }
    else if(kipas_out  == 1024)
    {
    analogWrite(enA, 1024 );
    digitalWrite(in1, HIGH);
    digitalWrite(in2, LOW);
    }
    
  last_kipas = kipas_out;
}
}
